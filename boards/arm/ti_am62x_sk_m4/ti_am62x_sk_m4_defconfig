## boards/arm/ti_am62x_sk_m4/ti_am62x_sk_m4_defconfig
```kconfig
# Texas Instruments Sitara AM62x-SK-M4 EVM
#
# Copyright (c) 2023 Texas Instruments Incorporated
# Copyright (c) 2023 L Lakshmanan
#
# SPDX-License-Identifier: Apache-2.0

# Platform Configuration
CONFIG_SOC_SERIES_AM62X_M4=y
CONFIG_SOC_AM62x_M4=y
CONFIG_BOARD_TI_AM62X_SK_M4=y
CONFIG_CORTEX_M_SYSTICK=y
CONFIG_SEMIHOST=y

# Zephyr Kernel Configuration
CONFIG_XIP=n

# Enable RAT module
CONFIG_REGION_ADDRESS_TRANSLATION=y
CONFIG_TI_RAT=y

# Enable Pinctrl
CONFIG_PINCTRL=y

# Serial Driver
CONFIG_SERIAL=y

CONFIG_UART_NS16550_ACCESS_WORD_ONLY=y

# Enable Console
CONFIG_CONSOLE=y
CONFIG_UART_CONSOLE=y
CONFIG_SEMIHOST_CONSOLE=y
```

## drivers/mm/rat/Kconfig
```kconfig
# Region Address Translation configuration options
#
# Copyright (c) 2023 Texas Instruments Incorporated
# Copyright (c) 2023 L Lakshmanan
# SPDX-License-Identifier: Apache-2.0

menuconfig REGION_ADDRESS_TRANSLATION
	bool "Region Address Translation (RAT) support"
	help
	  This option enables RAT support.

if REGION_ADDRESS_TRANSLATION

config TI_RAT
	bool "Texas Instruments RAT module"
	help
	  Enables RAT support functions specific to TI SoCs.

endif # REGION_ADDRESS_TRANSLATION
```

## drivers/pinctrl/Kconfig.ti_k3
```kconfig
# Copyright (c) 2023 Enphase Energy
# SPDX-License-Identifier: Apache-2.0

config PINCTRL_TI_K3
	bool "TI K3 pinctrl driver"
	default y
	depends on DT_HAS_TI_K3_PINCTRL_ENABLED
	help
	  Enable the TI K3 pinctrl driver

config RAT_TI_K3_M4
	bool "Region based Address Translation Module"
	default n
	depends on SOC_SERIES_AM62X_M4
	help 
	  Enable the RAT module for TI K3 SoCs that require it for address translation
```

## drivers/rat/Kconfig
```kconfig
# Region Address Translation configuration options
#
# Copyright (c) 2023 Texas Instruments Incorporated
# Copyright (c) 2023 L Lakshmanan
# SPDX-License-Identifier: Apache-2.0

menuconfig REGION_ADDRESS_TRANSLATION
	bool "Region Address Translation (RAT) support"
	help
	  This option enables RAT support.
```

## soc/arm/ti_k3/am62x_m4/Kconfig.soc
```kconfig
# Texas Instruments Sitara AM62x-SK-M4 EVM
#
# Copyright (c) 2023 L Lakshmanan
#
# SPDX-License-Identifier: Apache-2.0

choice
prompt "TI AM62X M4 Selection"
depends on SOC_SERIES_AM62X_M4

config SOC_AM62x_M4
	bool "TI AM62x M4"
	select SOC_PART_NUMBER_AM62x

endchoice

config SOC_PART_NUMBER_AM62x
	bool

config SOC_PART_NUMBER_AM62X_M4
	string
	default "AM62x" if SOC_PART_NUMBER_AM62x
	help
	  Full part number of the SoC. Do not select directly.

config SOC_PART_NUMBER
	default SOC_PART_NUMBER_AM62X_M4 if SOC_SERIES_AM62X_M4

config RAT_TI_K3_M4
	bool "Region based Address Translation Module"
	default y
	depends on SOC_SERIES_AM62X_M4
	help 
	  Enable the RAT module for TI K3 SoCs that require it for address translation
```
